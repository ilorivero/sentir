## firmware/meower-sentir/idf/main/Kconfig.projbuild
```kconfig
menu "SENTIR Meower"
    config SENTIR_ADS_COUNT
        int "Numero de ADS1299 (0 = detectar no boot)"
        range 0 2
        default 0
    config SENTIR_FAKE_ADC
        bool "ADS1299 emulado (testar sem a placa; NUNCA com participantes)"
        default n
    config SENTIR_FAKE_ADS_COUNT
        int "ADS1299 emulados"
        depends on SENTIR_FAKE_ADC
        range 1 2
        default 1
    config SENTIR_FAKE_PD_PIN
        int "GPIO lido como fotodiodo no modo emulado (-1 = onda de 1 Hz)"
        depends on SENTIR_FAKE_ADC
        default -1
endmenu
```

## firmware/meower-sentir/idf/sdkconfig.defaults
```kconfig
# Arduino como componente
CONFIG_AUTOSTART_ARDUINO=y
CONFIG_FREERTOS_HZ=1000
CONFIG_ARDUINO_SELECTIVE_COMPILATION=y
CONFIG_ARDUINO_SELECTIVE_WiFi=y
CONFIG_ARDUINO_SELECTIVE_Network=y
CONFIG_ARDUINO_SELECTIVE_AsyncUDP=y
CONFIG_ARDUINO_SELECTIVE_Preferences=y
CONFIG_ARDUINO_SELECTIVE_WebServer=y
CONFIG_ARDUINO_SELECTIVE_FS=y
CONFIG_ARDUINO_SELECTIVE_Hash=y
CONFIG_ARDUINO_SELECTIVE_SPI=y
# ESP32-C3 do Meower
CONFIG_IDF_TARGET="esp32c3"
CONFIG_ESP_DEFAULT_CPU_FREQ_MHZ_160=y
CONFIG_ESPTOOLPY_FLASHMODE_DIO=y
CONFIG_ESPTOOLPY_FLASHSIZE_4MB=y
CONFIG_PARTITION_TABLE_SINGLE_APP_LARGE=y
CONFIG_COMPILER_OPTIMIZATION_PERF=y
# console de log da IDF no USB-Serial/JTAG (o Serial do Arduino usa o mesmo USB)
CONFIG_ESP_CONSOLE_USB_SERIAL_JTAG=y
```

## firmware/oasis-sentir/idf/main/Kconfig.projbuild
```kconfig
menu "SENTIR Oasis"
    config SENTIR_FAKE_SENSORS
        bool "Sensores simulados (testar sem MAX30102/MLX90614/AHT20/BMP280; NUNCA em coleta)"
        default n
endmenu
```

## firmware/oasis-sentir/idf/sdkconfig.defaults
```kconfig
CONFIG_AUTOSTART_ARDUINO=y
CONFIG_FREERTOS_HZ=1000
CONFIG_ARDUINO_SELECTIVE_COMPILATION=y
CONFIG_ARDUINO_SELECTIVE_Wire=y
CONFIG_ARDUINO_SELECTIVE_SPI=y
CONFIG_IDF_TARGET="esp32c3"
CONFIG_ESPTOOLPY_FLASHMODE_DIO=y
CONFIG_ESPTOOLPY_FLASHSIZE_4MB=y
CONFIG_ESP_CONSOLE_USB_SERIAL_JTAG=y
```
